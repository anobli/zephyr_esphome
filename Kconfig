## Kconfig
```kconfig
# Copyright (c) 2025 Alexandre Bailon
# SPDX-License-Identifier: Apache-2.0
#

rsource "subsys/net/lib/esphome/Kconfig"
```

## dts/bindings/misc/esphome/nabucasa,esphome-sensor-temperature.yaml
```yaml
# A YAML binding matching the node

compatible: "nabucasa,esphome-sensor-temperature"
description: "Enable support of esphome tenmperature sensor"

include: [base.yaml, "nabucasa,esphome-entity.yaml"]

properties:
    sensor:
      type: phandle
      required: true
    device_class:
      type: string
      enum:
        - "temperature"
      required: true
    unit:
      type: string
      enum:
        - "°C"
        - "°F"
      required: false
```

## west.yml
```yaml
# Copyright (c) 2024 Alexandre Bailon
# SPDX-License-Identifier: Apache-2.0

manifest:
  self:
    west-commands: scripts/west-commands.yml

  remotes:
    - name: zephyrproject-rtos
      url-base: https://github.com/zephyrproject-rtos
    - name: anobli
      url-base: https://github.com/anobli/

  projects:
    - name: zephyr
      remote: zephyrproject-rtos
      revision: main
      import: true
    - name: protobuf-c
      revision: a41892bb04cbd9fad18e32953c3fb1498f93ce70
      path: modules/lib/protobuf-c
      remote: anobli
```
