## templates/Kconfig
```kconfig
# Copyright (c) 2024 Alexandre Bailon
# SPDX-License-Identifier: Apache-2.0

choice
        prompt "{{ PROJECT }}_RPC log level limit"
        default {{ PROJECT }}_RPC_LOG_LEVEL_DEFAULT

config {{ PROJECT }}_RPC_LOG_LEVEL_DEFAULT
        bool "System limit (LOG_MAX_LEVEL)"

config {{ PROJECT }}_RPC_LOG_LEVEL_DBG
        bool "Debug"

config {{ PROJECT }}_RPC_LOG_LEVEL_INF
        bool "Info"

config {{ PROJECT }}_RPC_LOG_LEVEL_WRN
        bool "Warning"

config {{ PROJECT }}_RPC_LOG_LEVEL_ERR
        bool "Error"

config {{ PROJECT }}_RPC_LOG_LEVEL_NONE
        bool "None"

endchoice

config {{ PROJECT }}_RPC_LOG_LEVEL
        int
        default 0 if {{ PROJECT }}_RPC_LOG_LEVEL_NONE
        default 1 if {{ PROJECT }}_RPC_LOG_LEVEL_ERR
        default 2 if {{ PROJECT }}_RPC_LOG_LEVEL_WRN
        default 3 if {{ PROJECT }}_RPC_LOG_LEVEL_INF
        default 4 if {{ PROJECT }}_RPC_LOG_LEVEL_DBG
        default 5 if {{ PROJECT }}_RPC_LOG_LEVEL_DEFAULT

config {{ PROJECT }}_RPC_DUMP
        bool "Dump input and output data"
        default n
```
